/dts-v1/;
/plugin/;

/ {
    compatible = "brcm,bcm2835";

    fragment@0 {
        target = <&spi0>;
        __overlay__ {
            status = "okay";
            #address-cells = <1>;
            #size-cells = <0>;

            disable_spidev@0xdead {
                status = "disabled";
                reg = <0>;
            };

            flash@0 {
                compatible = "w25q16bv";
                reg = <0>; /* CS0 */
                spi-max-frequency = <50000000>;
                status = "okay";
            };
        };
    };
};
